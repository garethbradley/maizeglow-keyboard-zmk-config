## boards/shields/maizeglow-old/Kconfig.shield
```kconfig
config SHIELD_MAIZEGLOW_LEFT
    def_bool $(shields_list_contains, MaizeGlow_left)

config SHIELD_MAIZEGLOW_RIGHT
    def_bool $(shields_list_contains, MaizeGlow_right)
```

## boards/shields/maizeglow/Kconfig.defconfig
```kconfig
# Copyright (c) 2020 The ZMK Contributors
# SPDX-License-Identifier: MIT

if SHIELD_MAIZEGLOW_LEFT

config ZMK_KEYBOARD_NAME
	default "MaizeGlow"
	
config ZMK_SPLIT_BLE_ROLE_CENTRAL
	default y
	
config ZMK_USB
	default y

endif

if SHIELD_MAIZEGLOW_LEFT || SHIELD_MAIZEGLOW_RIGHT # || SHIELD_ENKI42_DONGLE 

config ZMK_SPLIT
	default y

config ZMK_BLE
	default y

config MAIZEGLOW_PM
    bool "MaizeGlow Automatic Power Management"
    default y
    select ZMK_POWER_DOMAINS
    select ZMK_POWER_DOMAINS_DYNAMIC_DEFAULT
    select PM_DEVICE
    select PM_DEVICE_POWER_DOMAIN
    select PM_DEVICE_RUNTIME
    select POWER_DOMAIN
    select POWER_DOMAIN_GPIO

config MAIZEGLOW_RGB_UNDERGLOW
    bool "MaizeGlow per Key RGB LEDs"
    default y
    select ZMK_RGB_UNDERGLOW
    select WS2812_STRIP
    select SPI
    select ZMK_RGB_UNDERGLOW_AUTO_OFF_IDLE
    select ZMK_RGB_UNDERGLOW_AUTO_OFF_USB

endif
```

## boards/shields/maizeglow/Kconfig.shield
```kconfig
# Copyright (c) 2020 The ZMK Contributors
# SPDX-License-Identifier: MIT

config SHIELD_MAIZEGLOW_LEFT
	def_bool $(shields_list_contains,MaizeGlow_left)

config SHIELD_MAIZEGLOW_RIGHT
	def_bool $(shields_list_contains,MaizeGlow_right)

# config SHIELD_ENKI42_DONGLE
# 	 def_bool $(shields_list_contains,enki42_dongle)
```

## boards/shields/nice_view_maizeglow/Kconfig.shield
```kconfig
# Copyright (c) 2020 The ZMK Contributors
# SPDX-License-Identifier: MIT

config SHIELD_NICE_VIEW_MAIZEGLOW
	def_bool $(shields_list_contains,nice_view_maizeglow)
```

## dts/bindings/mpr121/zephyr,mpr121.yaml
```yaml
# Copyright (c) 2021 Nordic Semiconductor ASA
# SPDX-License-Identifier: Apache-2.0

description: |
  An integration for the NXP MPR121 capacitive touch sensor.

  Example definition in devicetree:

    mpr121 {
        compatible = "zephyr,mpr121";
        input-gpios = <&gpio0 0 (GPIO_PULL_UP | GPIO_ACTIVE_LOW)>;
    };

compatible: "zephyr,mpr121"

include: base.yaml

properties:
  input-gpios:
    type: phandle-array
    required: true
    description: Input GPIO to be sensed.
```
