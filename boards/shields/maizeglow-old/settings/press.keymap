// PRESS OPTIONS
&mt {
    tapping-term-ms = <200>;
    quick_tap_ms = <0>;
    flavor = "tap-preferred";
};

&lt {
    tapping-term-ms = <200>;
    quick_tap_ms = <0>;
    flavor = "tap-preferred";
};

&sk {
    release-after-ms = <500>;
    quick-release;
};