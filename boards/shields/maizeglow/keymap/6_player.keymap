player_layer {
    label = "PLAYER";
    display-name = "PLAYER";

    bindings = <
    //╭─────────────────┬─────────────────┬─────────────────┬─────────────────┬──────────────────┬──────────────────╮  ╭───────┬───────┬───────┬───────┬───────┬───────╮
        &bt BT_PRV        &bt BT_CLR_ALL    &bt BT_NXT        &none             &none              &none                 &none   &none   &none   &none   &none   &none
    //├─────────────────┼─────────────────┼─────────────────┼─────────────────┼──────────────────┼──────────────────┤  ├───────┼───────┼───────┼───────┼───────┼───────┤
        &rgb_ug RGB_EFR   &rgb_ug RGB_ON    &rgb_ug RGB_OFF   &rgb_ug RGB_EFF   &none              &none                 &none   &none   &none   &none   &none   &none
    //├─────────────────┼─────────────────┼─────────────────┼─────────────────┼──────────────────┼──────────────────┤  ├───────┼───────┼───────┼───────┼───────┼───────┤
        &to BASE          &none             &none             &kp C_PREV        &kp C_NEXT         &none                 &none   &none   &none   &none   &none   &none
    //╰─────────────────┴─────────────────┴─────────────────┼─────────────────┼──────────────────┼──────────────────┤  ├───────┼───────┼───────┼───────┴───────┴───────╯
                                                              &kp C_VOL_DN      &kp C_PLAY_PAUSE   &kp C_VOL_UP          &none   &none   &none
    //                                                      ╰─────────────────┴──────────────────┴──────────────────╯  ╰───────┴───────┴───────╯
    >;
};