lower_layer {
    label = "LOWER";
    display-name = "LOWER";

    bindings = <
    //╭───────────┬────────────┬────────────┬────────────┬──────────────┬────────────╮  ╭───────────┬───────────┬────────────┬───────────┬───────────┬──────────╮
        &kp ESC     &kp N1       &kp N2       &kp N3       &kp N4         &kp N5          &kp N6      &kp N7      &kp N8       &kp N9      &kp N0      &screenshot
    //├───────────┼────────────┼────────────┼────────────┼──────────────┼────────────┤  ├───────────┼───────────┼────────────┼───────────┼───────────┼──────────┤
        &kp LCTRL   &to NUMBER   &tab_prev    &kp UP       &mo EXTRA      &mo UBER        &kp EQUAL   &kp MINUS   &kp UP       &kp LBKT    &kp RBKT    &kp BSLH
    //├───────────┼────────────┼────────────┼────────────┼──────────────┼────────────┤  ├───────────┼───────────┼────────────┼───────────┼───────────┼──────────┤
        &kp LSHFT   &none        &kp LEFT     &kp DOWN     &kp RIGHT      &to PLAYER      &none       &kp LEFT    &kp DOWN     &kp RIGHT   &kp INS     &kp DEL
    //╰───────────┴────────────┴────────────┼────────────┼──────────────┼────────────┤  ├───────────┼───────────┼────────────┼───────────┴───────────┴──────────╯
                                              &kp LALT     &mo LOWER      &kp SPACE       &kp ENTER   &kp RALT    &kp LGUI
    //                                      ╰────────────┴──────────────┴────────────╯  ╰───────────┴───────────┴───────────╯
    >;
};